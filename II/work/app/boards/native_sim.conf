## II/work/app/boards/native_sim.conf
```kconfig
CONFIG_GPIO=y

CONFIG_I2C=y
CONFIG_SENSOR=y
CONFIG_LSM6DSL_TRIGGER_OWN_THREAD=y
CONFIG_LIS2MDL_TRIGGER_NONE=y
CONFIG_CBPRINTF_FP_SUPPORT=y


CONFIG_EMUL=y
CONFIG_I2C_EMUL=y
CONFIG_EMUL_HTS221=y
CONFIG_EMUL_LPS22HB=y

# # Za log
# CONFIG_LOG=y
# CONFIG_SENSOR_LOG_LEVEL_DBG=y
# CONFIG_SENSOR_INFO=y
# CONFIG_ASSERT=y

# CONFIG_LOG_MODE_DEFERRED=n

# CONFIG_LOG_DEFAULT_LEVEL=4

# CONFIG_I2C_LOG_LEVEL_DBG=y
```
